/*
 * Thumble - DONGLE (Xiao nRF52840 + Prospector adapter, ILI9341 320x240).
 * Pure BLE central: no local kscan. Hosts the keymap and physical layout so
 * ZMK Studio can edit them; the display is wired up by prospector_adapter.
 */

#include <input/processors.dtsi>
#include "thumble.dtsi"

/*
 * Receiving end of the keyboard's TPS65: an input-split endpoint with the same
 * reg as the peripheral side (thumble_i2c.dtsi), plus the listener that feeds
 * the events into ZMK's pointing/mouse HID.
 */
/ {
    split_inputs {
        #address-cells = <1>;
        #size-cells = <0>;

        trackpad_split: trackpad_split@0 {
            compatible = "zmk,input-split";
            reg = <0>;
        };
    };

    trackpad_listener {
        compatible = "zmk,input-listener";
        device = <&trackpad_split>;
        /*
         * Pointer sensitivity (multiplier / divisor), currently stock 1:1.
         * 3/2 together with the 3072 x 2048 pad resolution felt floaty.
         * Applied here on the dongle, after the BLE link, so it adds no radio
         * traffic; the scaler carries fractional remainders between reports,
         * so slow movement isn't lost. E.g. <&zip_xy_scaler 3 2> = 1.5x,
         * <&zip_xy_scaler 2 3> = ~0.67x.
         */
        input-processors = <&zip_xy_scaler 1 1>;
    };
};
