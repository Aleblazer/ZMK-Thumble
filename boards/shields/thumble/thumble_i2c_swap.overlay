/*
 * Diagnostic only: swaps SDA and SCL on the trackpad bus in firmware, to test
 * whether the TPS65 breakout/cable crosses them. Build as the second shield
 * after "thumble" (see build.yaml). The pins are on P0.17 (SDA) and P0.20
 * (SCL) normally.
 */

&i2c0_default {
    group1 {
        psels = <NRF_PSEL(TWIM_SDA, 0, 20)>,
                <NRF_PSEL(TWIM_SCL, 0, 17)>;
    };
};

&i2c0_sleep {
    group1 {
        psels = <NRF_PSEL(TWIM_SDA, 0, 20)>,
                <NRF_PSEL(TWIM_SCL, 0, 17)>;
    };
};
